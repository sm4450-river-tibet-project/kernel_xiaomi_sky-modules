## xiaomi/Kconfig
```kconfig
# SPDX-License-Identifier: GPL-2.0-only
#
# Xiaomi vendor modules for sky / sm4450 (parrot / ravelin)
# Ported from MiCode/Xiaomi_Kernel_OpenSource sky-t-oss (Linux 5.10.160)
# to the CLO 6.12 ACK stack.

config XIAOMI_TOUCH
	tristate "Xiaomi touch game-mode interface"
	depends on ARCH_RAVELIN || COMPILE_TEST
	help
	  Xiaomi touch vendor interface (/dev/xiaomi-touch). Provides the
	  game-mode / palm-sensor ioctl surface used by MIUI touch features.

config XIAOMI_TOUCH_NOTIFIER
	tristate "Xiaomi touch notifier"
	help
	  Blocking notifier chain used by the Xiaomi touch driver.

config XIAOMI_PANEL_NOTIFIER
	tristate "Xiaomi panel notifier"
	help
	  Blocking notifier chain used by the Xiaomi display driver.

config XIAOMI_USB_TOUCH_NOTIFIER
	tristate "Xiaomi USB touch notifier"
	help
	  Blocking notifier chain used by the Xiaomi USB touch driver.

config XIAOMI_HEADSET_TOUCH_NOTIFIER
	tristate "Xiaomi headset touch notifier"
	help
	  Blocking notifier chain used by the Xiaomi headset touch driver.

config MI_THERMAL_INTERFACE
	tristate "Xiaomi thermal message interface"
	depends on THERMAL
	help
	  Xiaomi thermal message interface (/sys/class/thermal/thermal_message)
	  used by MIUI thermal profiles.
```
